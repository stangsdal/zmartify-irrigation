## components/hmi_board/Kconfig
```kconfig
menu "HMI Board"

choice HMI_DISPLAY_PROFILE
    prompt "HMI display profile"
    default HMI_DISPLAY_PROFILE_LOW_RISK
    help
        Select the display timing profile for the 7B RGB panel.

config HMI_DISPLAY_PROFILE_LOW_RISK
    bool "Low risk (14 MHz pixel clock)"
    help
        Conservative profile with lower pixel clock for maximum signal margin.

config HMI_DISPLAY_PROFILE_HIGH_THROUGHPUT
    bool "High throughput (30.85 MHz pixel clock)"
    help
        Matches the Waveshare/LVGL example timing for smoother full-screen UI.

endchoice

config HMI_SCREEN_BLANK_TIMEOUT_SECONDS
    int "Screen blank timeout in seconds"
    default 300
    range 0 86400
    help
        Turn the display backlight off after this many seconds without touch input.
        Set to 0 to keep the display backlight on indefinitely.

endmenu
```

## sdkconfig.defaults
```kconfig
CONFIG_BOOTLOADER_APP_ROLLBACK_ENABLE=y
CONFIG_SECURE_SIGNED_APPS_NO_SECURE_BOOT=y
CONFIG_SECURE_SIGNED_APPS_RSA_SCHEME=y
CONFIG_SECURE_SIGNED_ON_UPDATE_NO_SECURE_BOOT=y
CONFIG_SECURE_BOOT_BUILD_SIGNED_BINARIES=y
CONFIG_SECURE_BOOT_SIGNING_KEY="keys/ota_signing_key.pem"
CONFIG_APP_PROJECT_VER_FROM_CONFIG=y
CONFIG_APP_PROJECT_VER="v5.2.1"
CONFIG_MQTT_PROTOCOL_5=y
CONFIG_ESPTOOLPY_FLASHSIZE_16MB=y
CONFIG_PARTITION_TABLE_TWO_OTA_LARGE=y
CONFIG_LWIP_LOCAL_HOSTNAME="zmartify-irrigation"
CONFIG_COMPILER_OPTIMIZATION_PERF=y
CONFIG_SPIRAM=y
CONFIG_SPIRAM_MODE_OCT=y
CONFIG_SPIRAM_TYPE_AUTO=y
CONFIG_SPIRAM_CLK_IO=30
CONFIG_SPIRAM_CS_IO=26
CONFIG_SPIRAM_FETCH_INSTRUCTIONS=y
CONFIG_SPIRAM_RODATA=y
CONFIG_SPIRAM_SPEED_40M=y
CONFIG_SPIRAM_BOOT_HW_INIT=y
CONFIG_SPIRAM_USE_MALLOC=y
CONFIG_SPIRAM_MEMTEST=y
CONFIG_SPIRAM_MALLOC_ALWAYSINTERNAL=16384
CONFIG_SPIRAM_TRY_ALLOCATE_WIFI_LWIP=y
CONFIG_SPIRAM_MALLOC_RESERVE_INTERNAL=32768
CONFIG_SPIRAM_ALLOW_STACK_EXTERNAL_MEMORY=y
CONFIG_ESP_MAIN_TASK_STACK_SIZE=8192
CONFIG_HMI_DISPLAY_PROFILE_LOW_RISK=y
# CONFIG_HMI_DISPLAY_PROFILE_HIGH_THROUGHPUT is not set
```
